#include "../../../display/qcomkit/elz/lahaina_sde_qrd_display.dtsi"

&devkit_lcd_panel {
	compatible = "devkit,lcd_panel_type";
	/* auto_key_info @ name: product_id type: uint32 default: 0 */
	product_id = <1000>;
	detect_type = <2>;
	/* auto_key_info @ name: gpio_id[2] type: int default: 0 */
	gpio_id = <84 85>;
	/* auto_key_info @ name: panel_type type: int default: 0 */
	panel_type = <3>;
	/* auto_key_info @ name: vddi_paras[6] type: int default: 0 */
	vddi_paras = <2 1 11 1800000 3 3>;
	/* auto_key_info @ name: dvdd_paras[6] type: int default: 0 */
	dvdd_paras = <0 2 36 1230000 3 3>;
	/* auto_key_info @ name: vci_paras[6] type: int default: 0 */
	vci_paras = <2 1 12 3000000 3 3>;
	/* auto_key_info @ name: bias_ctrl_type type: uint32 default: 0 */
	bias_ctrl_type = <0>;
	/* auto_key_info @ name: vsp_config[6] type: uint32 default: 0 */
	vsp_config = <0 0 0 6000 0 0>;
	/* auto_key_info @ name: vsn_config[6] type: uint32 default: 0 */
	vsn_config = <0 0 0 6000 0 0>;
	/* auto_key_info @ name: lcd_reset_gpio type: uint32 default: 0 */
	lcd_reset_gpio = <24>;
	/* auto_key_info @ name: tp_reset_gpio type: uint32 default: 0 */
	tp_reset_gpio = <0>;
	/* auto_key_info @ name: te_gpio type: uint32 default: 0 */
	te_gpio = <82>;
	/* auto_key_info @ name: bl_chip_type type: uint32 default: 0 */
	bl_chip_type = <0>;
	/* auto_key_info @ name: bl_enable[4] type: uint32 default: 0 */
	bl_enable = <0 0 0 0>;
	/* auto_key_info @ name: sec_gpio_id[2] type: int default: 0 */
	sec_gpio_id = <0 0>;
	/* auto_key_info @ name: sec_panel_type type: int default: 0 */
	sec_panel_type = <0>;
	/* auto_key_info @ name: sec_vddi_paras[6] type: int default: 0 */
	sec_vddi_paras = <0 0 11 1800000 0 0>;
	/* auto_key_info @ name: sec_dvdd_paras[6] type: int default: 0 */
	sec_dvdd_paras = <0 0 36 1230000 0 0>;
	/* auto_key_info @ name: sec_vci_paras[6] type: int default: 0 */
	sec_vci_paras = <0 0 12 3000000 0 0>;
	/* auto_key_info @ name: sec_bias_ctrl_type type: uint32 default: 0 */
	sec_bias_ctrl_type = <0>;
	/* auto_key_info @ name: sec_vsp_config[6] type: uint32 default: 0 */
	sec_vsp_config = <0 0 0 6000 0 0>;
	/* auto_key_info @ name: sec_vsn_config[6] type: uint32 default: 0 */
	sec_vsn_config = <0 0 0 6000 0 0>;
	/* auto_key_info @ name: sec_lcd_reset_gpio type: uint32 default: 0 */
	sec_lcd_reset_gpio = <0>;
	/* auto_key_info @ name: sec_tp_reset_gpio type: uint32 default: 0 */
	sec_tp_reset_gpio = <0>;
	/* auto_key_info @ name: sec_te_gpio type: uint32 default: 0 */
	sec_te_gpio = <0>;
	/* auto_key_info @ name: sec_bl_chip_type type: uint32 default: 0 */
	sec_bl_chip_type = <0>;
	/* auto_key_info @ name: sec_bl_enable[4] type: uint32 default: 0 */
	sec_bl_enable = <0 0 0 0>;
	support_lcd_type = "LCD_KIT";
};
