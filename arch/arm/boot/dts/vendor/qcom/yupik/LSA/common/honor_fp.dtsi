/* fingerprint panel config */
&soc {
	huawei_fingerprint {
		compatible = "fpc,fingerprint";
		fingerprint,reset_gpio = <&tlmm 130 0>;
		fingerprint,custom_timing_scheme = <2>;
		fingerprint,use_tp_irq = <1>;
		status = "ok";
	};
};
&fingerprint {
	fingerprint,product = "lisa";
	fingerprint,force_storage = <1>;
	fingerprint,sensor_type = <516>;
	fingerprint,top_left_corner_x = <406>; /* only for UD */
	fingerprint,top_left_corner_y = <866>; /* only for UD */
	fingerprint,bottom_right_corner_x = <586>; /* only for UD */
	fingerprint,bottom_right_corner_y = <947>; /* only for UD */
	fingerprint,tp_hover_support = <0>;
	fingerprint,radius = <99>;
	fingerprint,fp_spi_device_id = <14>;
};
