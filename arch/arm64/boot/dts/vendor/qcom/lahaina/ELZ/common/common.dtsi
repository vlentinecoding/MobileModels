#include "../../common/common.dtsi"
#include "honor_tp.dtsi"
#include "honor_fp.dtsi"
#include "honor_audio.dtsi"
#include "honor_dp.dtsi"
#include "honor_fac.dtsi"
#include "huawei_charger.dtsi"
#include "honor_sensor.dtsi"
#include "honor_vibrator.dtsi"
#include "honor_wifi.dtsi"
#include "honor_antenna_board_detect.dtsi"
#include "honor_hardware_detector.dtsi"
