&qupv3_se9_i2c {
	nfc@28 {
		compatible = "nxp,nq-pn544";
		status = "ok";
		reg = <0x28>;
		nxp,nfc_int = <&tlmm 41 0x00>;
		nxp,nfc_ven = <&tlmm 34 0x00>;
		nxp,nfc_firm = <&tlmm 40 0x00>;
		nfc_nxp_conf_name = "libnfc-nxp-sn110.conf";
		nfc_brcm_conf_name = "libnfc-brcm-sn110.conf";
		nfc_card_num = <0x2>;
		nfc_chip_type = "nfc_sz";
		nfc_ese_type = "p61";
		nfc_single_channel = "false";
		nfc_ese_num = <0x1>;
	};
};

&nfc_exist {
	nfc_exist_flag = "1";
	hisee_exist_flag = "0";
	nfc_ese_spi_det = "1";
	status = "ok";
};

&ese_config {
	nfc_ese_num_dts = <2>;
	ese_config_spi_bus = <14>;
	gpio_spi_cs = <59>;
	gpio_ese_irq = <0>;
	gpio_ese_reset = <0>;
	svdd_pwr_req_need = <0>;
	gpio_svdd_pwr_req = <0>;
	spi_switch_need = <0>;
	gpio_spi_switch = <0>;
	status = "ok";
};
