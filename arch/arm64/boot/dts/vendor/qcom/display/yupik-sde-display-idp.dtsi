#include "yupik-sde-display.dtsi"

&dsi_sim_vid {
	qcom,panel-supply-entries = <&dsi_panel_pwr_supply_labibb>;
	qcom,mdss-dsi-bl-pmic-control-type = "bl_ctrl_dcs";
	qcom,platform-reset-gpio = <&tlmm 44 0>;
};

&sde_dsi {
};

