#include <dt-bindings/interrupt-controller/irq.h>
#include <dt-bindings/interrupt-controller/arm-gic.h>
#include <dt-bindings/pinctrl/mt6853-pinfunc.h>
/dts-v1/;
/plugin/;

#include "huawei_mt6853_frl_an00a_vf/huawei.dtsi"

&rootparam {
    mtk,boardid = <4 0 9 6>;
    mtk,board_name = "FRL_AN00A_VF";
    mtk,product_name = "FRL-AN00A";
    hardware_version = "HL6FRLM";
};

#include <k6853v1_64/cust.dtsi>

/*End of this file, DO NOT ADD ANYTHING HERE*/