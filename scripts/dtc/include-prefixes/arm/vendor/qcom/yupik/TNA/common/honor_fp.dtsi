/* fingerprint panel config */
&soc {
	huawei_fingerprint {
		compatible = "fpc,fingerprint";
		fingerprint,reset_gpio = <&tlmm 130 0>;
		fingerprint,custom_timing_scheme = <2>;
		fingerprint,use_tp_irq = <1>;
		status = "ok";
	};
};
&fingerprint {
	fingerprint,product = "tina";
	fingerprint,force_storage = <1>;
	fingerprint,sensor_type = <516>;
	fingerprint,top_left_corner_x = <411>; /* only for UD */
	fingerprint,top_left_corner_y = <869>; /* only for UD */
	fingerprint,bottom_right_corner_x = <589>; /* only for UD */
	fingerprint,bottom_right_corner_y = <949>; /* only for UD */
	fingerprint,tp_hover_support = <0>;
	fingerprint,radius = <109>;
	fingerprint,fp_spi_device_id = <14>;
};
