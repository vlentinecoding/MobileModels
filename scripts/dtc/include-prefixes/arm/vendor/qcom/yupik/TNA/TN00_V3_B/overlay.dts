/dts-v1/;
/plugin/;

#include "../common/common.dtsi"
#include "honor-nfc.dtsi"
#include "honor-camera.dtsi"
#include "huawei_charger.dtsi"
#include "honor-wifi.dtsi"

/ {
    /* bsp_replace_info @ model = "Honor Technologies, Inc. %product_name%"; */
    model = "Honor Technologies, Inc. TNA-TN00-780-100";
    compatible = "qcom,yupik-qrd", "qcom,yupik", "qcom,qrd";
    /* bsp_replace_info @ qcom,board-id = <%boardid% 0>; */
    qcom,board-id = <8577 0>;
};

&rootparam {
    /* bsp_replace_info @ qcom,boardid = <%boardid_split%>; */
    /* auto_key_info @ name: boardid type: uint32 default: 0 */
    qcom,boardid = <8 5 7 7>;
    /* bsp_replace_info @ qcom,board_name = "%board_name%"; */
    qcom,board_name = "TNA_TN00_V3_B";
    /* bsp_replace_info @ qcom,product_name = "TNA-AN00-780-100"; */
    qcom,product_name = "TNA-TN00-780-100";
    /* bsp_replace_info @ hardware_version = "%hardware_version%"; */
    hardware_version = "HN1TNAM";
};
