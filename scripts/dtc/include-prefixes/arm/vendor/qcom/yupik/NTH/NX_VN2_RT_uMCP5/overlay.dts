/dts-v1/;
/plugin/;

#include "../common/common.dtsi"
#include "devkit-lcd.dtsi"
#include "honor_audio.dtsi"
#include "honor-nfc.dtsi"
#include "honor-camera.dtsi"
#include "huawei_charger.dtsi"
#include "honor-wifi.dtsi"

/ {
    /* bsp_replace_info @ model = "Honor Technologies, Inc. %product_name%"; */
    model = "Honor Technologies, Inc. NTH-NX9-777-206";
    compatible = "qcom,yupik-qrd", "qcom,yupik", "qcom,qrd";
    /* bsp_replace_info @ qcom,board-id = <%boardid% 0>; */
    qcom,board-id = <8940 0>;
};

&rootparam {
    /* bsp_replace_info @ qcom,boardid = <%boardid_split%>; */
    /* auto_key_info @ name: boardid type: uint32 default: 0 */
    qcom,boardid = <8 9 4 0>;
    /* bsp_replace_info @ qcom,board_name = "%board_name%"; */
    qcom,board_name = "NTH_NX_VN2_RT_uMCP5";
    /* bsp_replace_info @ qcom,product_name = "%product_name%"; */
    qcom,product_name = "NTH-NX9-777-207";
    /* bsp_replace_info @ hardware_version = "%hardware_version%"; */
    hardware_version = "HN3NTHM";
};

&antenna_board_detect {
    antenna_board_match_range = <850 1290>;
};
