&spmi_bus {
	qcom,pm8350b@3 {
		qcom,hv-haptics@f000 {
			status="disabled";
		};
		pm7250b_vib: qcom,vibrator@df00 {
			compatible = "qcom,qpnp-vibrator-ldo";
			reg = <0xdf00>;
			qcom,vib-ldo-volt-uv = <3000000>;
			qcom,disable-overdrive;
		};
	};
};
