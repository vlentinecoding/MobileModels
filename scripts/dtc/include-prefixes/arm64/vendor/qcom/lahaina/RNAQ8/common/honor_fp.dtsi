/* fingerprint panel config */
&soc {
	huawei_fingerprint {
		compatible = "fpc,fingerprint";
		fingerprint,reset_gpio = <&tlmm 38 0>;
		 fingerprint,avdd_en_gpio = <&tlmm 39 0>;
		fingerprint,custom_timing_scheme = <2>;
		fingerprint,use_tp_irq = <1>;
		status = "ok";
	};
};
&fingerprint {
	fingerprint,product = "elz";
	fingerprint,force_storage = <1>;
	fingerprint,sensor_type = <516>;
	fingerprint,top_left_corner_x = <420>; /* only for UD */
	fingerprint,top_left_corner_y = <878>; /* only for UD */
	fingerprint,bottom_right_corner_x = <580>; /* only for UD */
	fingerprint,bottom_right_corner_y = <956>; /* only for UD */
	fingerprint,tp_hover_support = <0>;
	fingerprint,radius = <108>;
};
