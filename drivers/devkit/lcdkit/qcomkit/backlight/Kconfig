## drivers/devkit/lcdkit/qcomkit/backlight/Kconfig
```kconfig
#
# lcdkit qcom backlight driver configuration
#

menuconfig LCD_QCOM_DRV
	bool "qcom lcd kit  backlight driver"
	default n
	help
	    If you say yes here you get support for lcd kit backlight driver.
```

## drivers/hardware_detector/Kconfig
```kconfig
config HARDWARE_DETECTOR
	default n
	bool "hardware detector"
	help
	  detect hardware dfr problem in factory version.
```

## drivers/hnvibrator/Kconfig
```kconfig
config HN_HAPTICS_WRAPPER
	tristate "wrapper for qcom-hv-haptics"
	depends on INPUT_QCOM_HV_HAPTICS
	default n
	help
	  Wrapper for qcom-hv-haptics, to support legacy haptics pattern

config HN_HAPTICS_VIBRATOR
        tristate "vibrator info"
        default n
        help
         Say yes if you want device detect driver.
          This is for device connected version. If unsure, say N here.

config HONOR_VIBRATOR_LDO
	tristate "Vibrator-LDO support for Independent LDO"
	depends on LEDS_CLASS
	help
	  This option enables device driver support for the vibrator-ldo
	  peripheral found on Honor Technologies, Inc.
	  The vibrator-ldo peripheral is capable of driving ERM vibrators.
```

## drivers/honor_spi_ir/Kconfig
```kconfig
config HONOR_SPI_IR
        tristate "Support for spi ir device"
        default y
        help
          Say Y to enable support spi ir device
```

## drivers/huawei_platform/Kconfig
```kconfig
config HUAWEI_DRIVERS
	bool "huawei drivers"
	default n
	help
	  Say Y here if you want to build the huawei drivers.
	  If unsure, say N here.

config HUAWEI_TOUCH_SCREEN
	bool "huawei touch screen driver"
	default n
	help
	  Say Y here if you have any touch device connected to your system and want
	  it to be available to applications.
	  Say N here if you have no touch device in your system.If unsure, say Y.
	  To compile this driver as a module, choose M here: the  module will be called input.

config HUAWEI_MSS_AUTO_CHANGE
	bool "Huawei MSS auto change undecoupled function support"
	default n

config HONOR_POWER
	bool "honor power"
	default n

config HONOR_USB
	bool "honor usb"
	default n

config HUAWEI_PLATFORM
	bool "huawei platform"
	default n

config HONOR_HWPOWER
	bool "honor hwpower"
	default n

source "drivers/huawei_platform/touchscreen/Kconfig"
source "drivers/huawei_platform/ioinfo/Kconfig"
source "drivers/huawei_platform/usb/Kconfig"
source "drivers/huawei_platform/power/Kconfig"
source "drivers/huawei_platform/card_tray/Kconfig"
source "drivers/huawei_platform/hihonor_oem_glink/Kconfig"
```

## drivers/huawei_platform/hihonor_oem_glink/Kconfig
```kconfig
config HIHONOR_OEM_GLINK
	bool "hihonor oem glink module"
        default n
        help
          Say Y here if you want to build the hihonor oem glink drivers.
          If unsure, say N here.
```

## drivers/huawei_platform/hwpower/hardware_ic/charger_ic/Kconfig
```kconfig
# SPDX-License-Identifier: GPL-2.0+
#
# charger ic drivers
#

config BQ2560X_CHARGER
	bool "bq2560x charger"
	default n
	help
	  Say Y here to enable bq2560x charger driver.

config RT9471_CHARGER
	bool "rt9471 charger"
	default n
	help
	  Say Y here to enable rt9471 charger driver.
```

## drivers/huawei_platform/leds/Kconfig
```kconfig
#
# leds info
#

menuconfig HUAWEI_LEDS
    bool "Huawei leds info"
    default n
    help
      Say yes if you want device detect driver.
      This is for device connected version. If unsure, say N here.

source "drivers/huawei_platform/leds/aw2015/Kconfig"
source "drivers/huawei_platform/leds/aw2016/Kconfig"
```

## drivers/huawei_platform/power/adsp/Kconfig
```kconfig
source "drivers/huawei_platform/power/adsp/dts/Kconfig"
source "drivers/huawei_platform/power/adsp/direct_charger/Kconfig"
source "drivers/huawei_platform/power/adsp/battery/Kconfig"
source "drivers/huawei_platform/power/adsp/charger/Kconfig"
source "drivers/huawei_platform/power/adsp/event/Kconfig"
source "drivers/huawei_platform/power/adsp/usb/Kconfig"
```

## drivers/huawei_platform/power/adsp/battery/Kconfig
```kconfig
#
# adsp battery drivers
#

config ADSP_BATTERY
        bool "adsp_battery"
        default n
```

## drivers/huawei_platform/power/adsp/charger/Kconfig
```kconfig
#
# adsp charger drivers
#

config ADSP_CHARGER
        bool "adsp_charger"
        default n
```

## drivers/huawei_platform/power/adsp/direct_charger/Kconfig
```kconfig
#
# adsp direct charger drivers
#

config ADSP_DIRECT_CHARGER
        bool "adsp_direct_charger"
        default n
```

## drivers/huawei_platform/power/adsp/event/Kconfig
```kconfig
#
# adsp ui event drivers
#

config ADSP_UI_EVENT
        bool "adsp_ui_event"
        default n
```

## drivers/huawei_platform/power/adsp/usb/Kconfig
```kconfig
#
# adsp usb drivers
#

config ADSP_USB
        bool "adsp_usb"
        default n
```

## drivers/huawei_platform/power/common_module/Kconfig
```kconfig
source "drivers/huawei_platform/power/common_module/power_mesg/Kconfig"
source "drivers/huawei_platform/power/common_module/uscp/Kconfig"
```

## drivers/huawei_platform/power/dubai/Kconfig
```kconfig
config HUAWEI_DUBAI
    tristate "Dubai State"
    help
        Dubai report state, please choose it.

config HUAWEI_DUBAI_BATTERY_STATS
	bool "Dubai battery stats (capacity_rm)"
	default n
	depends on HUAWEI_DUBAI
	help
		This config is mainly for getting capacity_rm value of power_supply.
		Please make sure there is POWER_SUPPLY_PROP_CAPACITY_RM.

config HUAWEI_DUBAI_GPU_STATS
	bool "Dubai gpu frequency stats"
	default n
	depends on HUAWEI_DUBAI

config HUAWEI_DUBAI_DDR_STATS
	bool "Dubai ddr stats"
	default n
	depends on HUAWEI_DUBAI
```

## drivers/huawei_platform/power/hardware_ic/fuel_gauge/Kconfig
```kconfig
#
# fuel gauge ic drivers
#
source "drivers/huawei_platform/power/hardware_ic/fuel_gauge/rt9426/Kconfig"

config FUEL_GAUGE
	bool "fuel gauge"
	default n
	help
	  Say Y here to enable fuel gauge.
config BQ27Z561_FUEL_GAUGE
	bool "bq27z561 fuel gauge"
	depends on FUEL_GAUGE
	default n
	help
	  Say Y here to enable bq27z561 fuel gauge driver.
	  this driver provides some interfaces to the coul.
	  also support a few high accuracy battery elements.
	  for example current and voltage.
```

## drivers/hwpower/cc_hardware_ic/Kconfig
```kconfig
#
# huawei hardware ic drivers
#

source "drivers/hwpower/cc_hardware_ic/buck_boost/Kconfig"
source "drivers/hwpower/cc_hardware_ic/charge_pump/Kconfig"
source "drivers/hwpower/cc_hardware_ic/switch_capacitor/Kconfig"
source "drivers/hwpower/cc_hardware_ic/boost_5v/Kconfig"
source "drivers/hwpower/cc_hardware_ic/wireless_charge_ic/Kconfig"
source "drivers/hwpower/cc_hardware_ic/charge_adc_monitor/Kconfig"
source "drivers/hwpower/cc_hardware_ic/fuel_gauge/Kconfig"

config I2C_OPERATION_IN_COMPLETE
        bool "i2c_operation_in_complete"
        default n
        help
        Say Y here to put i2c operation in complete api.

config CHARGER_CHECK_I2C
        bool "charger_check_i2c"
        default n
        help
        Say Y here to check i2c in charger.
```

## drivers/hwpower/cc_hardware_ic/fuel_gauge/Kconfig
```kconfig
#
# fuel gauge ic drivers
#

config CW2217_FUEL_GAUGE
	bool "cw2217 fuel gauge"
	depends on FUEL_GAUGE
	default n
	help
	  Say Y here to enable cw2217 fuel gauge driver.
	  this driver provides some interfaces to the coul.
	  also support a few high accuracy battery elements.
	  for example current and voltage.
```

## drivers/hwsensor/Kconfig
```kconfig
config HUAWEI_HALL_SENSORS
        bool "huawei hall sensors"
		default n
        help
          Say Y here if you want to build the huawei hall sensor drivers.
		  If unsure, say N here.

source "drivers/hwsensor/hallsensor/Kconfig"
config HUAWEI_LP_SENSORS
        bool "huawei als and proximity sensors"
		default n
        help
          Say Y here if you want to build the huawei als and proximity sensor drivers.
		  If unsure, say N here.

source "drivers/hwsensor/lpsensor/Kconfig"
config SENSOR_DEVELOP_TEST
        bool "Support for sensor develop selftest"
		default n
        help
          Say Y here if you want to build develop test sensor connected with ap side.
		  If unsure, say N here.
#config HUAWEI_SENSOR_INFO
#        tristate "Support for sensor self_adapt"
#        depends on HUAWEI_KERNEL
#        default n
#        help
#          Say Y to enable support self-adapt

config HUAWEI_SENSOR_INFO
        tristate "Support for sensor self_adapt"
        default n
        help
          Say Y to enable support self-adapt
config HUAWEI_PS_SENSOR
        bool "huawei ps sensor"
		default n
        help
          Say Y here if you want to build the huawei thp sensor drivers.
		  If unsure, say N here.

source "drivers/hwsensor/pssensor/Kconfig"

config HUAWEI_SAR_SENSOR
        bool "huawei sar sensor"
		default n
        help
          Say Y here if you want to build the huawei sar sensor drivers.
		  If unsure, say N here.

source "drivers/hwsensor/sarsensor/Kconfig"

config HUAWEI_COLOR_SENSOR
        bool "honor color sensor"
		default y
        help
          Say Y here if you want to build the honor color sensor drivers.
		  If unsure, say N here.

source "drivers/hwsensor/colorsensor/Kconfig"

config HONOR_SENSOR_EVENT
        bool "honor sensor event"
               default n
        help
          Say Y here if you want to build the honor sensor event drivers.
                 If unsure, say N here.

source "drivers/hwsensor/sensorevent/Kconfig"
```

## drivers/hwsensor/colorsensor/Kconfig
```kconfig
config SENSORS_DAX
        tristate "AMS-TAOS DAX"
        depends on I2C
        default y
        help
          If you say yes here you get support for the ams-taos dax sensor

config SENSORS_3408
        tristate "AMS-TCS 3408"
        depends on I2C
        default y
        help
          If you say yes here you get support for the ams-tcs 3408 sensor

config SENSORS_27006
        tristate "ROHM BU27006"
        depends on I2C
        default y
        help
          If you say yes here you get support for the rohm bu27006 sensor
```

## drivers/hwsensor/sensorevent/Kconfig
```kconfig
#
# sensorevent report configuration
#

config SENSOREVENT
    tristate "sensorevent"
    depends on HONOR_SENSOR_EVENT
    default y
    help
      add this to support sensorevent
```

## drivers/input/misc/dtof/ams/ams_tmf8820/Kconfig
```kconfig
config SENSORS_TMF882X
	tristate "AMS-TAOS TMF882X TOF"
    	depends on I2C
	default n
 	help
	  If you say yes here you get support for the ams-taos tmf882x,
	  ToF distance sensors.
​
	  This driver can also be built as a module.  If so, the module
	  will be called tmf882x.

config TMF882X_QCOM_AP
	bool "AMS-TAOS TMF882X TOF QUALCOMM KERNEL"
    	depends on SENSORS_TMF882X
	default n
 	help
	  If you say yes here you get support for the ams-taos tmf882x,
	  ToF distance sensors with Qualcomm linux kernel additions.

config CONFIG_TMF882X_NO_HISTOGRAM_SUPPORT
	bool "AMS-TAOS TMF882X TOF DISABLE HISTOGRAM SUPPORT"
    	depends on SENSORS_TMF882X
	default n
 	help
	  If you say yes here you disable support for histograms
      in the ams tmf882x driver. (Save code space, memory usage)
```

## drivers/nfc/st21nfc/Kconfig
```kconfig
#
# Near Field Communication (NFC) devices
#
config NFC_ST21NFC
	tristate "ST21NFC driver"
	depends on I2C
	select CRC_CCITT
	default n
	---help---
	  ST21NFC Near Field Communication driver.
	  This is for i2c connected version. If unsure, say N here.

	  To compile this driver as a module, choose m here. The module will
	  be called pn547/pn548.
```
