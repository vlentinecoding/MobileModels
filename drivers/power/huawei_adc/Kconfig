## drivers/rawdata_oper_log_collector/Kconfig
```kconfig
#
# honor device state monitor configuration
#

config RAWDATA_OPER_LOG_COLLECTOR
	bool "Rawdata Oper Log Collector"
	default n
	help
	  If you say yes here you get support for Rawdata Oper Log Collector solution.
```

## drivers/sched_affinity/Kconfig
```kconfig
config TASK_AFFINITY_NOTI
    bool "notify task affinity"
    default n
    help
      if set, current scene id will be reported to the cpufeature
```

## drivers/soc/qcom/dp/Kconfig
```kconfig
config HONOR_DP_CUST
	tristate "Support for dp cust"
	default n
	help
	  Say Y here if you want to support dp cust

config HONOR_DP_FACTORY
	tristate "Support for dp factory"
	default n
	depends on HONOR_DP_CUST
	help
	  Say Y here if you want to support dp factory

config HONOR_DP_DSM
	tristate "Support for dp dsm"
	default n
	depends on HONOR_DP_CUST
	help
	  Say Y here if you want to support dp dsm
```

## drivers/soc/qcom/pil-q6v5-mss/Kconfig
```kconfig
#
# HUAWEI modem interface
#
config HUAWEI_MODEM_CRASH_LOG
	tristate "modem crash exception for apr"
	default n

config SUBSYS_CRASH_REASON_UPLOAD
	bool "Collect subsystem crash log for COMMERCIAL_USER or OVERSEA_COMMERCIAL_USER"
	default n
	help
	  Save subsystem crash reason to /data/log/reliability/faultdect and
	  upload to dir Logsevice/901/
```

## drivers/soc/qcom/usb_analog_hs/Kconfig
```kconfig
config USB_ANALOG_HS
	tristate "Support for usb analog headset"
	default n
	help
	  Say Y here if you want to support usb analog headset

config USB_ANALOG_HS_MOS
	tristate "Support for usb analog headset with MOS switch"
	default n
	depends on USB_ANALOG_HS
	help
	  Say Y here if you want to support usb analog headset with MOS switch
```

## drivers/tzdriver/Kconfig
```kconfig
menu "TEE OS"

config TZDRIVER
	tristate "Secure Execution Communicator driver"
	default n
	help
	  Provides a communication interface between userspace and
	  TrustZone Operating Environment.

config HISI_SECBOOT_IMG
	bool "tzdriver split secboot img into modem and ap"
	default n
	depends on KERNEL_CLIENT
	help
	  Macro defined for splitting modem and ap img

config HISI_SECBOOT_IMG_V2
	bool "tzdriver split modem and ap for v2"
	default n
	depends on KERNEL_CLIENT
	help
	  Macro defined for splitting modem and ap img v2

config ASAN_DEBUG
	bool "hisi ASAN debug version"
	default n
	help
	  Macro defined for ASAN debug version

config TZDRIVER_MODULE
	bool "tz driver for whole module "
	default n
	help
	  Macro defined for complie it as module

config TZDRIVER_SVM
	bool "tz driver for htee svm "
	default n
	help
	  Macro defined for htee svm

config TZ_DRIVER_KERNEL4
	bool "tz driver for kernel 4.x "
	default n
	help
	  Macro defined for linux kernel 4.x

source  "drivers/tzdriver/auth/Kconfig"
source  "drivers/tzdriver/core/Kconfig"
source  "drivers/tzdriver/ion/Kconfig"
source  "drivers/tzdriver/tlogger/Kconfig"
source  "drivers/tzdriver/tui/Kconfig"
source  "drivers/tzdriver/ca_antiroot/Kconfig"
source  "drivers/tzdriver/agent_rpmb/Kconfig"

endmenu
```

## fs/crypto/Kconfig
```kconfig
config FS_ENCRYPTION
	tristate "FS Encryption (Per-file encryption)"
	select CRYPTO
	select CRYPTO_AES
	select CRYPTO_CBC
	select CRYPTO_ECB
	select CRYPTO_XTS
	select CRYPTO_CTS
	select CRYPTO_CTR
	select CRYPTO_SHA256
	select KEYS
	help
	  Enable encryption of files and directories.  This
	  feature is similar to ecryptfs, but it is more memory
	  efficient since it avoids caching the encrypted and
	  decrypted pages in the page cache.
config FS_UNI_ENCRYPTION
	depends on FS_ENCRYPTION
	tristate "FS Universal Encryption (Per-file encryption)"
	help
	  Enable universal encryption for files and directories.
```

## kernel/sched/hw_rt/Kconfig
```kconfig
menu "RT Capacity Aware"

config HW_RT_ACTIVE_LB
	bool "HW RT Capacity Aware Misfit Task"
	default n
	help
	  Check and migrate the RT process to a more suitable
	  CPU in the tick.

endmenu
```

## kernel/sched/hw_task/Kconfig
```kconfig
config HW_ED_TASK
	bool "Huawei early detection tasks for frequency guidance"
	depends on SCHED_WALT
	default n
	help
	  Huawei early detection tasks for frequency guidance.
```

## kernel/sched/hw_walt/Kconfig
```kconfig
#
# Huawei enhanced options for sched walt
#

if SCHED_WALT

config HW_SCHED_PRED_LOAD
	bool "Calculate predicted load for each task"
	default y
	depends on HW_CPU_FREQ_GOV_SCHEDUTIL && SCHED_WALT
	help
	  Another signal to improve schedutil. This will help to ramp up
	  cpufreq quickly.
	  To enable this signal, say yes here and set predl_enable to 1
	  in init rc.

config HW_SCHED_CHECK_IRQLOAD
	bool "Scheduler check irqload when select task's cpu"
	default y
	help
	  WALT caculates an irqload for each cpu and scheduler will avoid
	  placing task on a high irqload cpu (if WALT enabled).

endif # SCHED_WALT
```

## security/kernel_stp/Kconfig
```kconfig
#
# Copyright (c) Honor Technologies Co., Ltd. 2018-2018. All rights reserved.
# Description: Honor kernel mdpp selftest configuration
# Author: sunhongqing <sunhongqing@honor.com>
# Cryptographic API Configuration
# Create: 2018-03-31
#

menu "Honor KERNEL STP"

config HW_KERNEL_STP
	tristate "enables Honor KERNEL STP"
	default n
	help
	  This option enables support for Honor kernel stp in kernel space.
	  Honor kernel stp is a security threat perception module at kernel.
	  each source of threat can report the risk info to native throught the kernel stp

config HW_KERNEL_STP_ENG_DEBUG
	bool "Honor KERNEL STP for engineering mode debug"
	depends on HW_KERNEL_STP
	default n
	help
	  This option should only be enabled for engineering mode & debug test.
	  In engineering mode, more debug info can be print for tester.

endmenu
```

## sound/hw_audio/Kconfig
```kconfig
config HW_AUDIO_INFO
    tristate "set audio info for self adapt"
	default n
	help
	  This is used to some audio self adatper configuration.
config AUDIO_CARD_FACTORY
    bool "set audio card to factory mode"
	default n
	help
	  This is used to enable factory mode.
```
